## Kconfig
```kconfig
# Kconfig for rts_ntc

menu "rts_ntc"

config RTS_NTC_ENABLE
    bool "Enable rts_ntc"
    default y
    help
        Select this to enable the rts_ntc component.

config RTS_NTC_IS_NTC_AT_UPPER
    bool "NTC resistor position"
    default n
    depends on RTS_NTC_ENABLE
    help
        Select the position of the NTC resistor in the circuit.
        If the NTC resistor is connected to VCC, select "Yes".
        If the NTC resistor is connected to GND, select "No".

endmenu
```
